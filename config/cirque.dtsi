/ {
    /* Der Empfänger auf der linken Seite */
    glidepoint_split_listener: glidepoint_split_listener {
        compatible = "zmk,input-listener";
        status = "disabled";
        device = <&glidepoint_split>;
    };

    /* Die Funk-Schnittstelle */
    split_inputs {
        #address-cells = <1>;
        #size-cells = <0>;

        glidepoint_split: glidepoint_split@0 {
            compatible = "zmk,input-split";
            reg = <0>;
        };
    };
};