## config/west.yml
```yaml
manifest:
  remotes:
    - name: zmkfirmware
      url-base: https://github.com/zmkfirmware
    - name: urob
      url-base: https://github.com/urob
    - name: petejohanson
      url-base: https://github.com/petejohanson
    - name: kbrd-space
      url-base: https://github.com/kbrd-space
#   - name: geeksville
#     url-base: https://github.com/geeksville
  projects:
    - name: zmk
      remote: zmkfirmware
      revision: v0.3 # Update auf 0.3 empfohlen
      import: app/west.yml
    - name: zmk-auto-layer
      remote: urob
      revision: v0.3 # Passend zu ZMK v0.3
    - name: zmk-anti-idle
      remote: kbrd-space
      revision: main
    - name: cirque-input-module
      remote: petejohanson
      revision: main
#    - name: cirque-input-module
#      remote: geeksville
#      revision: main
  self:
    path: config
```
